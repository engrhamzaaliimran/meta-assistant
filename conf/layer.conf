## conf/layer.conf
```bitbake
# We have a conf and classes directory, add to BBPATH
BBPATH .= ":${LAYERDIR}"

# We have recipes-* directories, add to BBFILES
BBFILES += "${LAYERDIR}/recipes-*/*/*.bb \
            ${LAYERDIR}/recipes-*/*/*.bbappend"

BBFILE_COLLECTIONS += "meta-assistant"
BBFILE_PATTERN_meta-assistant = "^${LAYERDIR}/"
BBFILE_PRIORITY_meta-assistant = "6"

LAYERDEPENDS_meta-assistant = "core"
LAYERSERIES_COMPAT_meta-assistant = "thud"
```
